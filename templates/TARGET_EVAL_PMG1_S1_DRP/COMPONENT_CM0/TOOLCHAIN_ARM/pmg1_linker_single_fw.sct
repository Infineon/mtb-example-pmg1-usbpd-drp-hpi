#! armclang -E --target=arm-arm-none-eabi -x c -mcpu=cortex-m0
; The first line specifies a preprocessor command that the linker invokes
; to pass a scatter file through a C preprocessor.

;*******************************************************************************
;* \file pmg1_linker_single_fw.sct
;* \version 1.0.0
;*
;* Linker file for the ARMCC.
;*
;* The main purpose of the linker script is to describe how the sections in the
;* input files should be mapped into the output file, and to control the memory
;* layout of the output file.
;*
;* \note The entry point location is fixed and starts at 0x00000000. The valid
;* application image should be placed there.
;*
;* \note The linker files included with the PDL template projects must be
;* generic and handle all common use cases. Your project may not use every
;* section defined in the linker files. In that case you may see the warnings
;* during the build process: L6314W (no section matches pattern) and/or L6329W
;* (pattern only matches removed unused sections). In your project, you can
;* suppress the warning by passing the "--diag_suppress=L6314W,L6329W" option to
;* the linker, simply comment out or remove the relevant code in the linker
;* file.
;*
;*******************************************************************************
;* \copyright
;* (c) (2019-2024), Cypress Semiconductor Corporation (an Infineon company) or
;* an affiliate of Cypress Semiconductor Corporation.
;*
;* SPDX-License-Identifier: Apache-2.0
;*
;* Licensed under the Apache License, Version 2.0 (the "License");
;* you may not use this file except in compliance with the License.
;* You may obtain a copy of the License at
;*
;*     http://www.apache.org/licenses/LICENSE-2.0
;*
;* Unless required by applicable law or agreed to in writing, software
;* distributed under the License is distributed on an "AS IS" BASIS,
;* WITHOUT WARRANTIES OR CONDITIONS OF ANY KIND, either express or implied.
;* See the License for the specific language governing permissions and
;* limitations under the License.
;******************************************************************************/

;* DFU SDK specific: includes defines common across all the applications
#include "pmg1_flash_map.h"


; The defines below describe the location and size of blocks of memory in the target.
; Use these defines to specify the memory regions available for allocation.

; The following defines control RAM and flash memory allocation.
; You can change the memory allocation by editing the RAM and Flash defines.

/*--------------------- Embedded RAM Configuration ---------------------------
; <h> RAM Configuration
;   <o0> RAM Base Address    <0x0-0xFFFFFFFF:8>
;   <o1> RAM Size (in Bytes) <0x0-0xFFFFFFFF:8>
; </h>
 *----------------------------------------------------------------------------*/
#define __RAM_START     0x20000000
#define __RAM_SIZE      0x00003000

/*--------------------- Flash Configuration ----------------------------------
; <h> Flash Configuration
;   <o0> Flash Base Address <0x0-0xFFFFFFFF:8>
;   <o1> Flash Size (in Bytes) <0x0-0xFFFFFFFF:8>
; </h>
 *----------------------------------------------------------------------------*/
#define __FLASH_START   0x00000000
#define __FLASH_SIZE    0x00020000

/*--------------------- Stack Configuration ---------------------------
; <h> Stack Configuration
;   <o0> Stack Size (in Bytes) <0x0-0xFFFFFFFF:8>
; </h>
 *----------------------------------------------------------------------------*/
#define __STACK_SIZE    0x00000400

/*---------------------------- Application Flash Section ---------------------*/
#define __FLASH_FW_START	CY_APP_FLASH_ADDR
#define __FLASH_FW_SIZE		CY_APP_FLASH_LENGTH

#define __FLASH_META_START	CY_BOOT_META_FLASH_ADDR
#define __FLASH_META_SIZE	CY_BOOT_META_FLASH_LENGTH

/*
;------------- <<< end of configuration section >>> ---------------------------
*/


LR_ROM __FLASH_FW_START __FLASH_FW_SIZE
{
    ER_ROM __FLASH_FW_START __FLASH_FW_SIZE
    {
        *.o (RESET, +First)
    }
    
    /* Place the version and silicon ID information 0xE0 bytes from the start location. */
    ER_ROM1 (__FLASH_FW_START + 0xE0) UNINIT FIXED
    { 
        * (.cy_base_version)
        * (.cy_app_version)
        * (.cy_dev_siliconid)
        * (.cy_fw_reserved) 
    }
    
    ER_ROM2 (__FLASH_FW_START + 0x100) FIXED
    {
    	*(InRoot$$Sections)
        .ANY (+RO)
        .ANY (+XO)
    }

    ER_RAM_VECTORS __RAM_START UNINIT
    {
        * (.bss.RESET_RAM, +FIRST)
    }
    
    cy_boot_run_type +0 UNINIT
    {
        *(.bss.cy_boot_run_type)
    }

    cy_boot_data_sig +0 UNINIT
    {
        *(.bss.cy_boot_data_sig)
    }

    cy_boot_img_status +0 UNINIT
    {
        *(.bss.cy_boot_img_status)
    }

    cy_boot_i2c_addr +0 UNINIT
    {
        *(.bss.cy_boot_i2c_addr)
    }
    
    RW_RAM_DATA +0
    {
        * (+RW, +ZI)
    }

    ; Place variables in the section that should not be initialized during the
    ; device startup.
    RW_IRAM1 +0 UNINIT
    {
        * (.noinit)
    }

    ; Application heap area (HEAP)
    ARM_LIB_HEAP  +0 EMPTY ((__RAM_START+__RAM_SIZE)-AlignExpr(ImageLimit(RW_IRAM1), 8)-__STACK_SIZE)
    {
    }

    ; Stack region growing down
    ARM_LIB_STACK (__RAM_START+__RAM_SIZE) EMPTY -__STACK_SIZE
    {
    }
}


CYBOOTMETA __FLASH_META_START __FLASH_META_SIZE
{
	.meta_padding +0
	{
		* (.meta_padding)
	}
	
	.cy_metadata +0
	{
		* (.cy_metadata)
	}
	
	.cy_app_signature +0
	{
		* (.cy_app_signature)
	}
}


; These sections are used for additional metadata (silicon revision, Silicon/JTAG ID, etc.) storage.
CYFLASHPROTECT 0x90400000
{
    .cyflashprotect +0 { * (.cyflashprotect) }
}

CYMETA 0x90500000
{
    .cymeta +0 { * (.cymeta) }
}

CYCHIPPROTECT 0x90600000
{
    .cychipprotect +0 { * (.cychipprotect) }
}


/* [] END OF FILE */
